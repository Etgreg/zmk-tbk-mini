## config/boards/shields/tbkmini/Kconfig.defconfig
```kconfig
if SHIELD_TBKMINI_LEFT

config ZMK_KEYBOARD_NAME
    default "Tbkmini Left"

config ZMK_SPLIT_BLE_ROLE_CENTRAL
    default y

endif

if SHIELD_TBKMINI_RIGHT

config ZMK_KEYBOARD_NAME
    default "Tbkmini Right"

endif

if  SHIELD_TBKMINI_LEFT ||  SHIELD_TBKMINI_RIGHT

config ZMK_SPLIT
    default y

endif
```
